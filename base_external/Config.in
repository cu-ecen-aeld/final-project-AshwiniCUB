## base_external/Config.in
```kconfig
source "$BR2_EXTERNAL_assignment_base_PATH/package/bme280/Config.in"
source "$BR2_EXTERNAL_assignment_base_PATH/package/final/Config.in"
```

## base_external/package/BME280/Config.in
```kconfig
config BR2_PACKAGE_BME280
	bool "BME280"
	help
	  Includes the files related to BME280 sensor which is used to get the
      sensor values like temp, pressure & humidity
```

## base_external/package/bme280/Config.in
```kconfig
config BR2_PACKAGE_BME280
	bool "bme280"
	help
	  Includes the files related to bme280 sensor which is used to get the
	  sensor values like temp, pressure & humidity
```

## base_external/package/final/Config.in
```kconfig
config BR2_PACKAGE_FINAL
	bool "final"
	help
	  Includes the files related to BME280 sensor which is used to get the
	  sensor values like temp, pressure & humidity
```
